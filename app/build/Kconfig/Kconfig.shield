## app/build/Kconfig/Kconfig.shield
```kconfig
osource "/Users/naim/Desktop/Projects/Work/ASELSIS/WEAVER_BIKE/my-workspace/ncs-example-application/boards/shields/*/Kconfig.shield"
osource "/Users/naim/Desktop/Projects/Work/ASELSIS/WEAVER_BIKE/my-workspace/nrf/boards/shields/*/Kconfig.shield"
```

## app/build/Kconfig/Kconfig.shield.defconfig
```kconfig
osource "/Users/naim/Desktop/Projects/Work/ASELSIS/WEAVER_BIKE/my-workspace/ncs-example-application/boards/shields/*/Kconfig.defconfig"
osource "/Users/naim/Desktop/Projects/Work/ASELSIS/WEAVER_BIKE/my-workspace/nrf/boards/shields/*/Kconfig.defconfig"
```

## app/build/Kconfig/boards/Kconfig
```kconfig
# Load Zephyr board Kconfig descriptions.
osource "/Users/naim/Desktop/Projects/Work/ASELSIS/WEAVER_BIKE/my-workspace/ncs-example-application/boards/Aselsis/weaver_bike/Kconfig"
```

## app/build/Kconfig/soc/Kconfig
```kconfig
# Load Zephyr SoC Kconfig descriptions.
osource "/Users/naim/Desktop/Projects/Work/ASELSIS/WEAVER_BIKE/my-workspace/zephyr/soc/xlnx/zynqmp/Kconfig"
osource "/Users/naim/Desktop/Projects/Work/ASELSIS/WEAVER_BIKE/my-workspace/zephyr/soc/xlnx/zynq7000/Kconfig"
osource "/Users/naim/Desktop/Projects/Work/ASELSIS/WEAVER_BIKE/my-workspace/zephyr/soc/xen/Kconfig"
osource "/Users/naim/Desktop/Projects/Work/ASELSIS/WEAVER_BIKE/my-workspace/zephyr/soc/ti/simplelink/Kconfig"
osource "/Users/naim/Desktop/Projects/Work/ASELSIS/WEAVER_BIKE/my-workspace/zephyr/soc/ti/lm3s6965/Kconfig"
osource "/Users/naim/Desktop/Projects/Work/ASELSIS/WEAVER_BIKE/my-workspace/zephyr/soc/ti/k3/Kconfig"
osource "/Users/naim/Desktop/Projects/Work/ASELSIS/WEAVER_BIKE/my-workspace/zephyr/soc/telink/tlsr/Kconfig"
osource "/Users/naim/Desktop/Projects/Work/ASELSIS/WEAVER_BIKE/my-workspace/zephyr/soc/starfive/jh71xx/Kconfig"
osource "/Users/naim/Desktop/Projects/Work/ASELSIS/WEAVER_BIKE/my-workspace/zephyr/soc/st/stm32/Kconfig"
osource "/Users/naim/Desktop/Projects/Work/ASELSIS/WEAVER_BIKE/my-workspace/zephyr/soc/snps/qemu_arc/Kconfig"
osource "/Users/naim/Desktop/Projects/Work/ASELSIS/WEAVER_BIKE/my-workspace/zephyr/soc/snps/nsim/arc_v/Kconfig"
osource "/Users/naim/Desktop/Projects/Work/ASELSIS/WEAVER_BIKE/my-workspace/zephyr/soc/snps/nsim/arc_classic/Kconfig"
osource "/Users/naim/Desktop/Projects/Work/ASELSIS/WEAVER_BIKE/my-workspace/zephyr/soc/snps/hsdk4xd/Kconfig"
osource "/Users/naim/Desktop/Projects/Work/ASELSIS/WEAVER_BIKE/my-workspace/zephyr/soc/snps/hsdk/Kconfig"
osource "/Users/naim/Desktop/Projects/Work/ASELSIS/WEAVER_BIKE/my-workspace/zephyr/soc/snps/emsk/Kconfig"
osource "/Users/naim/Desktop/Projects/Work/ASELSIS/WEAVER_BIKE/my-workspace/zephyr/soc/snps/emsdp/Kconfig"
osource "/Users/naim/Desktop/Projects/Work/ASELSIS/WEAVER_BIKE/my-workspace/zephyr/soc/snps/arc_iot/Kconfig"
osource "/Users/naim/Desktop/Projects/Work/ASELSIS/WEAVER_BIKE/my-workspace/zephyr/soc/silabs/Kconfig"
osource "/Users/naim/Desktop/Projects/Work/ASELSIS/WEAVER_BIKE/my-workspace/zephyr/soc/sifive/sifive_freedom/Kconfig"
osource "/Users/naim/Desktop/Projects/Work/ASELSIS/WEAVER_BIKE/my-workspace/zephyr/soc/sensry/Kconfig"
osource "/Users/naim/Desktop/Projects/Work/ASELSIS/WEAVER_BIKE/my-workspace/zephyr/soc/rockchip/Kconfig"
osource "/Users/naim/Desktop/Projects/Work/ASELSIS/WEAVER_BIKE/my-workspace/zephyr/soc/renode/riscv_virtual/Kconfig"
osource "/Users/naim/Desktop/Projects/Work/ASELSIS/WEAVER_BIKE/my-workspace/zephyr/soc/renode/cortex_r8_virtual/Kconfig"
osource "/Users/naim/Desktop/Projects/Work/ASELSIS/WEAVER_BIKE/my-workspace/zephyr/soc/renesas/smartbond/Kconfig"
osource "/Users/naim/Desktop/Projects/Work/ASELSIS/WEAVER_BIKE/my-workspace/zephyr/soc/renesas/rzt2m/Kconfig"
osource "/Users/naim/Desktop/Projects/Work/ASELSIS/WEAVER_BIKE/my-workspace/zephyr/soc/renesas/rcar/Kconfig"
osource "/Users/naim/Desktop/Projects/Work/ASELSIS/WEAVER_BIKE/my-workspace/zephyr/soc/renesas/ra/Kconfig"
osource "/Users/naim/Desktop/Projects/Work/ASELSIS/WEAVER_BIKE/my-workspace/zephyr/soc/raspberrypi/Kconfig"
osource "/Users/naim/Desktop/Projects/Work/ASELSIS/WEAVER_BIKE/my-workspace/zephyr/soc/quicklogic/eos_s3/Kconfig"
osource "/Users/naim/Desktop/Projects/Work/ASELSIS/WEAVER_BIKE/my-workspace/zephyr/soc/qemu/virt_riscv/Kconfig"
osource "/Users/naim/Desktop/Projects/Work/ASELSIS/WEAVER_BIKE/my-workspace/zephyr/soc/qemu/malta/Kconfig"
osource "/Users/naim/Desktop/Projects/Work/ASELSIS/WEAVER_BIKE/my-workspace/zephyr/soc/openisa/rv32m1/Kconfig"
osource "/Users/naim/Desktop/Projects/Work/ASELSIS/WEAVER_BIKE/my-workspace/zephyr/soc/nxp/s32/Kconfig"
osource "/Users/naim/Desktop/Projects/Work/ASELSIS/WEAVER_BIKE/my-workspace/zephyr/soc/nxp/rw/Kconfig"
osource "/Users/naim/Desktop/Projects/Work/ASELSIS/WEAVER_BIKE/my-workspace/zephyr/soc/nxp/mcx/Kconfig"
osource "/Users/naim/Desktop/Projects/Work/ASELSIS/WEAVER_BIKE/my-workspace/zephyr/soc/nxp/lpc/Kconfig"
osource "/Users/naim/Desktop/Projects/Work/ASELSIS/WEAVER_BIKE/my-workspace/zephyr/soc/nxp/layerscape/Kconfig"
osource "/Users/naim/Desktop/Projects/Work/ASELSIS/WEAVER_BIKE/my-workspace/zephyr/soc/nxp/kinetis/Kconfig"
osource "/Users/naim/Desktop/Projects/Work/ASELSIS/WEAVER_BIKE/my-workspace/zephyr/soc/nxp/imxrt/Kconfig"
osource "/Users/naim/Desktop/Projects/Work/ASELSIS/WEAVER_BIKE/my-workspace/zephyr/soc/nxp/imx/Kconfig"
osource "/Users/naim/Desktop/Projects/Work/ASELSIS/WEAVER_BIKE/my-workspace/zephyr/soc/nuvoton/numicro/Kconfig"
osource "/Users/naim/Desktop/Projects/Work/ASELSIS/WEAVER_BIKE/my-workspace/zephyr/soc/nuvoton/numaker/Kconfig"
osource "/Users/naim/Desktop/Projects/Work/ASELSIS/WEAVER_BIKE/my-workspace/zephyr/soc/nuvoton/npcx/Kconfig"
osource "/Users/naim/Desktop/Projects/Work/ASELSIS/WEAVER_BIKE/my-workspace/zephyr/soc/nuvoton/npcm/Kconfig"
osource "/Users/naim/Desktop/Projects/Work/ASELSIS/WEAVER_BIKE/my-workspace/zephyr/soc/nordic/Kconfig"
osource "/Users/naim/Desktop/Projects/Work/ASELSIS/WEAVER_BIKE/my-workspace/zephyr/soc/neorv32/Kconfig"
osource "/Users/naim/Desktop/Projects/Work/ASELSIS/WEAVER_BIKE/my-workspace/zephyr/soc/native/inf_clock/Kconfig"
osource "/Users/naim/Desktop/Projects/Work/ASELSIS/WEAVER_BIKE/my-workspace/zephyr/soc/microchip/miv/Kconfig"
osource "/Users/naim/Desktop/Projects/Work/ASELSIS/WEAVER_BIKE/my-workspace/zephyr/soc/microchip/mec/Kconfig"
osource "/Users/naim/Desktop/Projects/Work/ASELSIS/WEAVER_BIKE/my-workspace/zephyr/soc/mediatek/mtk_adsp/Kconfig"
osource "/Users/naim/Desktop/Projects/Work/ASELSIS/WEAVER_BIKE/my-workspace/zephyr/soc/lowrisc/opentitan/Kconfig"
osource "/Users/naim/Desktop/Projects/Work/ASELSIS/WEAVER_BIKE/my-workspace/zephyr/soc/litex/litex_vexriscv/Kconfig"
osource "/Users/naim/Desktop/Projects/Work/ASELSIS/WEAVER_BIKE/my-workspace/zephyr/soc/ite/ec/Kconfig"
osource "/Users/naim/Desktop/Projects/Work/ASELSIS/WEAVER_BIKE/my-workspace/zephyr/soc/intel/raptor_lake/Kconfig"
osource "/Users/naim/Desktop/Projects/Work/ASELSIS/WEAVER_BIKE/my-workspace/zephyr/soc/intel/lakemont/Kconfig"
osource "/Users/naim/Desktop/Projects/Work/ASELSIS/WEAVER_BIKE/my-workspace/zephyr/soc/intel/intel_socfpga_std/Kconfig"
osource "/Users/naim/Desktop/Projects/Work/ASELSIS/WEAVER_BIKE/my-workspace/zephyr/soc/intel/intel_socfpga/Kconfig"
osource "/Users/naim/Desktop/Projects/Work/ASELSIS/WEAVER_BIKE/my-workspace/zephyr/soc/intel/intel_niosv/Kconfig"
osource "/Users/naim/Desktop/Projects/Work/ASELSIS/WEAVER_BIKE/my-workspace/zephyr/soc/intel/intel_ish/Kconfig"
osource "/Users/naim/Desktop/Projects/Work/ASELSIS/WEAVER_BIKE/my-workspace/zephyr/soc/intel/intel_adsp/Kconfig"
osource "/Users/naim/Desktop/Projects/Work/ASELSIS/WEAVER_BIKE/my-workspace/zephyr/soc/intel/elkhart_lake/Kconfig"
osource "/Users/naim/Desktop/Projects/Work/ASELSIS/WEAVER_BIKE/my-workspace/zephyr/soc/intel/atom/Kconfig"
osource "/Users/naim/Desktop/Projects/Work/ASELSIS/WEAVER_BIKE/my-workspace/zephyr/soc/intel/apollo_lake/Kconfig"
osource "/Users/naim/Desktop/Projects/Work/ASELSIS/WEAVER_BIKE/my-workspace/zephyr/soc/intel/alder_lake/Kconfig"
osource "/Users/naim/Desktop/Projects/Work/ASELSIS/WEAVER_BIKE/my-workspace/zephyr/soc/infineon/cat3/Kconfig"
osource "/Users/naim/Desktop/Projects/Work/ASELSIS/WEAVER_BIKE/my-workspace/zephyr/soc/infineon/cat1b/Kconfig"
osource "/Users/naim/Desktop/Projects/Work/ASELSIS/WEAVER_BIKE/my-workspace/zephyr/soc/infineon/cat1a/Kconfig"
osource "/Users/naim/Desktop/Projects/Work/ASELSIS/WEAVER_BIKE/my-workspace/zephyr/soc/gd/gd32/Kconfig"
osource "/Users/naim/Desktop/Projects/Work/ASELSIS/WEAVER_BIKE/my-workspace/zephyr/soc/gaisler/leon3/Kconfig"
osource "/Users/naim/Desktop/Projects/Work/ASELSIS/WEAVER_BIKE/my-workspace/zephyr/soc/gaisler/gr716a/Kconfig"
osource "/Users/naim/Desktop/Projects/Work/ASELSIS/WEAVER_BIKE/my-workspace/zephyr/soc/espressif/Kconfig"
osource "/Users/naim/Desktop/Projects/Work/ASELSIS/WEAVER_BIKE/my-workspace/zephyr/soc/ene/kb1200/Kconfig"
osource "/Users/naim/Desktop/Projects/Work/ASELSIS/WEAVER_BIKE/my-workspace/zephyr/soc/efinix/sapphire/Kconfig"
osource "/Users/naim/Desktop/Projects/Work/ASELSIS/WEAVER_BIKE/my-workspace/zephyr/soc/cdns/xtensa_sample_controller/Kconfig"
osource "/Users/naim/Desktop/Projects/Work/ASELSIS/WEAVER_BIKE/my-workspace/zephyr/soc/cdns/dc233c/Kconfig"
osource "/Users/naim/Desktop/Projects/Work/ASELSIS/WEAVER_BIKE/my-workspace/zephyr/soc/brcm/bcmvk/Kconfig"
osource "/Users/naim/Desktop/Projects/Work/ASELSIS/WEAVER_BIKE/my-workspace/zephyr/soc/brcm/bcm2712/Kconfig"
osource "/Users/naim/Desktop/Projects/Work/ASELSIS/WEAVER_BIKE/my-workspace/zephyr/soc/brcm/bcm2711/Kconfig"
osource "/Users/naim/Desktop/Projects/Work/ASELSIS/WEAVER_BIKE/my-workspace/zephyr/soc/atmel/sam0/Kconfig"
osource "/Users/naim/Desktop/Projects/Work/ASELSIS/WEAVER_BIKE/my-workspace/zephyr/soc/atmel/sam/Kconfig"
osource "/Users/naim/Desktop/Projects/Work/ASELSIS/WEAVER_BIKE/my-workspace/zephyr/soc/aspeed/Kconfig"
osource "/Users/naim/Desktop/Projects/Work/ASELSIS/WEAVER_BIKE/my-workspace/zephyr/soc/arm/Kconfig"
osource "/Users/naim/Desktop/Projects/Work/ASELSIS/WEAVER_BIKE/my-workspace/zephyr/soc/arm/beetle/Kconfig"
osource "/Users/naim/Desktop/Projects/Work/ASELSIS/WEAVER_BIKE/my-workspace/zephyr/soc/andestech/Kconfig"
osource "/Users/naim/Desktop/Projects/Work/ASELSIS/WEAVER_BIKE/my-workspace/zephyr/soc/ambiq/Kconfig"
osource "/Users/naim/Desktop/Projects/Work/ASELSIS/WEAVER_BIKE/my-workspace/zephyr/soc/altr/zephyr_nios2f/Kconfig"
osource "/Users/naim/Desktop/Projects/Work/ASELSIS/WEAVER_BIKE/my-workspace/zephyr/soc/altr/qemu_nios2/Kconfig"
osource "/Users/naim/Desktop/Projects/Work/ASELSIS/WEAVER_BIKE/my-workspace/zephyr/soc/adi/max32/Kconfig"
```
